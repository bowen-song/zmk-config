## config/boards/shields/lotus58g/Kconfig.shield
```kconfig
# Copyright (c) 2022 The ZMK Contributors
# SPDX-License-Identifier: MIT

config SHIELD_LOTUS58G_LEFT
	def_bool $(shields_list_contains,lotus58g_left)

config SHIELD_LOTUS58G_RIGHT
	def_bool $(shields_list_contains,lotus58g_right)
```
